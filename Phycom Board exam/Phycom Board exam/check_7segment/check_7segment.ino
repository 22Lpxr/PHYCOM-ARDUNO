/*
  =============================================================================
  [PHYCOM EXAM] 6. โค้ดตรวจสอบจอแสดงผล 7-Segment (แบบ Common Cathode 1 หลัก)
  =============================================================================

  📖 แผนผังขาและการต่อสาย (Pinout & Wiring Instructions):
  -----------------------------------------------------------------------------
  จอ 7-Segment ขนาด 1 หลัก มี 10 ขา (ด้านบน 5 ขา และด้านล่าง 5 ขา):
  (ดูตามภาพ `7-segment-display-pin-diagr_0.png` ในโฟลเดอร์ข้อสอบ)

     [ ขาด้านบน: เรียงซ้ายไปขวา ]
       - ขา 10 (g)   ---> ต่อเข้าช่อง Pin 8 บนบอร์ด Arduino
       - ขา 9  (f)   ---> ต่อเข้าช่อง Pin 7 บนบอร์ด Arduino
       - ขา 8  (com) ---> ต่อผ่าน "ตัวต้านทาน 330 โอห์ม" ลงช่อง GND บนบอร์ด
       - ขา 7  (a)   ---> ต่อเข้าช่อง Pin 2 บนบอร์ด Arduino
       - ขา 6  (b)   ---> ต่อเข้าช่อง Pin 3 บนบอร์ด Arduino

     [ ขาด้านล่าง: เรียงซ้ายไปขวา ]
       - ขา 1  (e)   ---> ต่อเข้าช่อง Pin 6 บนบอร์ด Arduino
       - ขา 2  (d)   ---> ต่อเข้าช่อง Pin 5 บนบอร์ด Arduino
       - ขา 3  (com) ---> ต่อผ่าน "ตัวต้านทาน 330 โอห์ม" ลงช่อง GND บนบอร์ด (เลือกต่อขา 3 หรือ 8 ขาใดขาหนึ่ง)
       - ขา 4  (c)   ---> ต่อเข้าช่อง Pin 4 บนบอร์ด Arduino
       - ขา 5  (DP)  ---> จุดทศนิยม (ไม่ต้องต่อ หรือต่อ Pin ใดเพื่อทดสอบ)

  💡 สรุปการเชื่อมต่อ Segment เข้ากับ Pin บอร์ด Arduino:
  -----------------------------------------------------------------------------
    Segment a ---> Pin 2
    Segment b ---> Pin 3
    Segment c ---> Pin 4
    Segment d ---> Pin 5
    Segment e ---> Pin 6
    Segment f ---> Pin 7
    Segment g ---> Pin 8
    Common Cathode (ขา 3 หรือ 8) ---> ต่อลง GND (ผ่านตัวต้านทาน 330 โอห์ม เพื่อถนอมหลอด)

  🔍 วิธีทดสอบและตรวจสอบผลลัพธ์ (How to Test & Expected Output):
  -----------------------------------------------------------------------------
  1. กด Upload โค้ดลงบอร์ด Arduino
  2. สังเกตหน้าจอ 7-Segment:
       - จอจะนับเลข 0 -> 1 -> 2 -> 3 -> 4 -> 5 -> 6 -> 7 -> 8 -> 9
       - เปลี่ยนตัวเลขทุกๆ 1 วินาที วนไปเรื่อยๆ
  3. วิธีสังเกตข้อผิดพลาด:
       - หากมีเส้นใดเส้นหนึ่งไม่ยอมติด เช่น เส้นกลาง (g) ดับตลอด ให้เช็คสายที่ Pin 8
       - หากตัวเลขแสดงผลเพี้ยน (เช่น เลข 3 กลายเป็นรูปแปลกๆ) แสดงว่าเสียบสลับขากันระหว่าง a..g
  =============================================================================
*/

// กำหนด Pin ดิจิทัลสำหรับ Segment a, b, c, d, e, f, g
const int segmentPins[] = {2, 3, 4, 5, 6, 7, 8};

// ตารางรหัสบิตของ 7-Segment แบบ Common Cathode (1 = จ่ายไฟให้ติด, 0 = ดับ)
// ลำดับแถวเรียงตามตัวเลข 0 ถึง 9 | ลำดับคอลัมน์เรียงตาม a, b, c, d, e, f, g
const byte digitTable[10][7] = {
  {1, 1, 1, 1, 1, 1, 0}, // ตัวเลข 0
  {0, 1, 1, 0, 0, 0, 0}, // ตัวเลข 1
  {1, 1, 0, 1, 1, 0, 1}, // ตัวเลข 2
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  {1, 1, 1, 1, 0, 1, 1}  // ตัวเลข 9
};

void displayNumber(int num) {
  if (num >= 0 && num <= 9) {
    for (int i = 0; i < 7; i++) {
      digitalWrite(segmentPins[i], digitTable[num][i]);
    }
  }
}

void setup() {
  Serial.begin(9600);
  for (int i = 0; i < 7; i++) {
    pinMode(segmentPins[i], OUTPUT);
  }
  delay(1000);
  Serial.println("==========================================");
  Serial.println("   7-Segment Display Diagnostic Test      ");
  Serial.println("==========================================");
}

void loop() {
  for (int n = 0; n <= 9; n++) {
    Serial.print("กำลังแสดงตัวเลข: ");
    Serial.println(n);
    displayNumber(n);
    delay(1000); // แสดงผลเลขละ 1 วินาที
  }
}
